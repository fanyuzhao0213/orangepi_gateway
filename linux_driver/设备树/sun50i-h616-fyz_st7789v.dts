/dts-v1/;
/plugin/;

/ {
    compatible = "allwinner,sun50i-h618";

    fragment@0 {
        target = <&spi1>;
        __overlay__ {
            status = "okay";
            #address-cells = <1>;
            #size-cells = <0>;

            st7789v@1 {
                compatible        = "sitronix,st7789v";
                reg               = <1>;                  /* CS1 = PH9 */
                spi-max-frequency = <10000000>;
                buswidth          = <8>;
                width             = <240>;
                height            = <320>;
                rotate            = <0>;
                fps               = <30>;
                dc-gpios          = <&pio 7 2 0>;         /* PH2  DC        */
                reset-gpios       = <&pio 7 3 1>;         /* PH3  RST 低有效 */
                led-gpios         = <&pio 8 13 0>;        /* PI13 BL        */
            };
        };
    };
};


